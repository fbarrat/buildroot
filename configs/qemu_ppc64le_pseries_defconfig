## configs/qemu_ppc64le_pseries_defconfig
```kconfig
# Architecture
BR2_powerpc64le=y
BR2_powerpc_power8=y

# System
BR2_BINUTILS_VERSION_2_38_X=y
BR2_TARGET_GENERIC_ROOT_PASSWD="passw0rd"
BR2_TARGET_GENERIC_GETTY_PORT="hvc0"
BR2_SYSTEM_DHCP="eth0"

# Filesystem
BR2_TARGET_ROOTFS_CPIO=y
# BR2_TARGET_ROOTFS_EXT2=y
# BR2_TARGET_ROOTFS_TAR is not set

# Image
BR2_ROOTFS_POST_IMAGE_SCRIPT="board/qemu/post-image.sh"
BR2_ROOTFS_POST_SCRIPT_ARGS="$(BR2_DEFCONFIG)"

# Linux headers same as kernel
BR2_PACKAGE_HOST_LINUX_HEADERS_CUSTOM_6_1=y

# Kernel
BR2_LINUX_KERNEL=y
BR2_LINUX_KERNEL_CUSTOM_VERSION=y
BR2_LINUX_KERNEL_CUSTOM_VERSION_VALUE="6.1.26"
BR2_LINUX_KERNEL_DEFCONFIG="pseries_le"
BR2_LINUX_KERNEL_VMLINUX=y
BR2_LINUX_KERNEL_CONFIG_FRAGMENT_FILES="board/qemu/ppc64le-pseries/linux.config.fragment"

BR2_PACKAGE_QEMU=y
BR2_PACKAGE_QEMU_SYSTEM=y
BR2_PACKAGE_QEMU_CHOOSE_TARGETS=y
BR2_PACKAGE_QEMU_TARGET_PPC64=y
BR2_PACKAGE_QEMU_SLIRP=y
BR2_PACKAGE_QEMU_FDT=y

BR2_PACKAGE_DROPBEAR=y
BR2_PACKAGE_DROPBEAR_DISABLE_REVERSEDNS=y
BR2_PACKAGE_PCIUTILS=y
BR2_PACKAGE_NUMACTL=y
# BR2_PACKAGE_KEXEC_LITE=y
# BR2_PACKAGE_IPMITOOL=y
# BR2_PACKAGE_SCREEN=y
# BR2_PACKAGE_POWERPC_UTILS=y


BR2_ROOTFS_POST_BUILD_SCRIPT="board/qemu/ppc64le-pseries/post-build.sh"
BR2_ROOTFS_OVERLAY="board/qemu/ppc64le-pseries/overlay"

BR2_CCACHE=y
```
